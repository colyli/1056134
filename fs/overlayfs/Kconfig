## fs/overlayfs/Kconfig
```kconfig
config OVERLAY_FS
	tristate "Overlay filesystem support"
	help
	  An overlay filesystem combines two filesystems - an 'upper' filesystem
	  and a 'lower' filesystem.  When a name exists in both filesystems, the
	  object in the 'upper' filesystem is visible while the object in the
	  'lower' filesystem is either hidden or, in the case of directories,
	  merged with the 'upper' object.

	  For more information see Documentation/filesystems/overlayfs.txt
config OVERLAY_FS_COMPAT
	bool "Overlay filesystem compatibility support"
	depends on OVERLAY_FS
	help
	  Versions of overlayfs prior to the implementation that was accepted
	  in the mainline kernel used a different interface for
	  whiteouts and didn't require the definition of a working directory.
	  In typical file system terms, this is a disk format change.  This
	  option allows the user to mount a file system using the 'overlayfs'
	  file system that enables the use of the old semantics.
```
